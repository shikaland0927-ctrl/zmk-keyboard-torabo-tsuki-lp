## Kconfig
```kconfig
menu "torabo-tsuki LP"

config ZMK_INPUT_PROCESSOR_GESTURES
    bool "Trackball flick gesture input processor"
    default y
    depends on ZMK_POINTING
    depends on DT_HAS_ZMK_INPUT_PROCESSOR_GESTURES_ENABLED
    depends on !ZMK_SPLIT || ZMK_SPLIT_ROLE_CENTRAL

config ZMK_BEHAVIOR_IPAD_MORPH
    bool "Behavior that picks its binding by host (Mac or the iPad's BLE profile)"
    default y
    depends on DT_HAS_ZMK_BEHAVIOR_IPAD_MORPH_ENABLED
    depends on !ZMK_SPLIT || ZMK_SPLIT_ROLE_CENTRAL

endmenu
```

## dts/bindings/behaviors/zmk,behavior-ipad-morph.yaml
```yaml
# Copyright (c) 2026 The ZMK Contributors
# SPDX-License-Identifier: MIT

description: >
  Invokes one of two bindings depending on the host. The second binding is used
  while the keyboard is sending to the BLE profile in ipad-ble-profile, the
  first one everywhere else (USB and every other BLE profile).

compatible: "zmk,behavior-ipad-morph"

include: zero_param.yaml

properties:
  bindings:
    type: phandle-array
    required: true
    description: Exactly two bindings, Mac first and iPad second
  ipad-ble-profile:
    type: int
    required: true
    description: BLE profile index the iPad is paired on
```
