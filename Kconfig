## Kconfig
```kconfig
menu "torabo-tsuki LP"

config ZMK_INPUT_PROCESSOR_GESTURES
    bool "Trackball flick gesture input processor"
    default y
    depends on ZMK_POINTING
    depends on DT_HAS_ZMK_INPUT_PROCESSOR_GESTURES_ENABLED
    depends on !ZMK_SPLIT || ZMK_SPLIT_ROLE_CENTRAL

endmenu
```

## config/west.yml
```yaml
manifest:
  remotes:
    - name: zmkfirmware
      url-base: https://github.com/zmkfirmware
    - name: shikaland0927-ctrl
      url-base: https://github.com/shikaland0927-ctrl
    - name: sekigon-gonnoc
      url-base: https://github.com/sekigon-gonnoc
  projects:
    # ZMK v0.3 + hold-tap balanced-key-positions (used by &my_mt)
    - name: zmk
      remote: shikaland0927-ctrl
      revision: v0.3-balanced-key-positions
      import: app/west.yml
    - name: zmk-component-bmp-boost
      remote: sekigon-gonnoc
      import: west.yml
      revision: v0.2
    - name: zmk-feature-status-led
      remote: sekigon-gonnoc
      revision: main
    - name: zmk-driver-paw3222
      remote: sekigon-gonnoc
      revision: torabo-tsuki
    - name: zmk-driver-iqs7211e
      remote: sekigon-gonnoc
    - name: zmk-feature-cdc-acm-bootloader-trigger
      remote: sekigon-gonnoc
      revision: v0.2
    - name: zmk-feature-non-lipo-battery-management
      remote: sekigon-gonnoc
      revision: main
  self:
    path: config
```

## dts/bindings/input_processors/zmk,input-processor-gestures.yaml
```yaml
# Copyright (c) 2026 The ZMK Contributors
# SPDX-License-Identifier: MIT

description: >
  Input processor for turning a quick flick of relative XY movement into one
  directional behavior tap. Ported from pite1222/zmk (Conductor firmware), with
  the bindings held by this node instead of keys on the gesture layer.

compatible: "zmk,input-processor-gestures"

include: ip_zero_param.yaml

properties:
  type:
    type: int
    description: Input event type to watch (default INPUT_EV_REL)
  x-code:
    type: int
    description: X axis event code (default INPUT_REL_X)
  y-code:
    type: int
    description: Y axis event code (default INPUT_REL_Y)
  threshold:
    type: int
    description: Movement on one axis that fires a gesture within timeout-ms (default 120)
  timeout-ms:
    type: int
    description: Window for reaching the threshold; slower movement is discarded (default 180)
  cooldown-ms:
    type: int
    description: Time after a gesture during which movement is ignored (default 220)
  tap-ms:
    type: int
    description: Press-to-release time of the tapped binding (default 30)
  bindings:
    type: phandle-array
    required: true
    description: Behaviors to tap for up, down, left, right (exactly four)
```

## dts/bindings/input_processors/zmk,input-processor-threshold-temp-layer.yaml
```yaml
# Copyright (c) 2024 The ZMK Contributors
# SPDX-License-Identifier: MIT

description: >
  Input processor for enabling a temporary layer after a movement threshold is reached.
  Share one instance between the pointing and mouse-button listeners to use one timeout.
  Movement and mouse-button events refresh the active layer's timeout. Held mouse buttons
  suspend expiry until the last button is released. Only X/Y movement can activate the layer.

compatible: "zmk,input-processor-threshold-temp-layer"

include: ip_two_param.yaml

properties:
  activation-threshold:
    type: int
    required: true
    description: Cumulative absolute X/Y movement required to activate the layer

  accumulation-window-ms:
    type: int
    required: false
    default: 100
    description: Time window in milliseconds used to accumulate X/Y movement

  require-prior-idle-ms:
    type: int
    required: false
    default: 0
    description: Time in milliseconds that must pass after the last keystroke before activation

  excluded-positions:
    type: array
    required: false
    default: []
    description: Key positions that do not deactivate the layer when pressed
```
